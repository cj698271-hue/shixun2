#include "oled_extra_font.h"
#include "oled.h"

/* ==================================================================
 * 32×32 字模 —— “你”
 * 取模方式：逐页式（每页8行），高位在上，低位在下
 * 与 font_32_32[] 中“欢”“迎”的格式完全一致
 * ================================================================== */
const u8 font_ni_32[128] = {
    0x00,0x00,0x00,0x00,0x00,0x00,0x80,0xE0,0x7E,0x1F,0x06,0x00,0x00,0x00,0x80,0xE0,
    0xF8,0x7F,0x4F,0x42,0x40,0x40,0x40,0x40,0x40,0x40,0x40,0xC0,0xC0,0xC0,0x00,0x00,
    0x20,0x20,0x70,0x38,0x1C,0x0F,0xFF,0xFF,0x00,0x00,0x10,0x18,0x3C,0x1F,0x07,0xC1,
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    0x08,0x18,0x18,0x18,0x0F,0x07,0x00,0x00,0x00,0x00,0x00,0x00,0x00,0x00,0x00,0x00
};

/* ==================================================================
 * 16×16 汉字字模（共10个）
 * 取模软件：PCtoLCD2002
 * 设置：阴码、逐行式、顺向（高位在前）、C51格式
 * 每个汉字32字节：前16字节为上半部分（8行），后16字节为下半部分（8行）
 * ================================================================== */

// 欢
const u8 font_16_huan[32] = {
    0x04,0x24,0x44,0x84,0x64,0x9C,0x40,0x30,0x0F,0xC8,0x08,0x08,0x28,0x18,0x00,0x00,
    0x10,0x08,0x06,0x01,0x82,0x4C,0x20,0x18,0x06,0x01,0x06,0x18,0x20,0x40,0x80,0x00
};

// 迎
const u8 font_16_ying[32] = {
    0x40,0x40,0x42,0xCC,0x00,0x00,0xFC,0x04,0x02,0x00,0xFC,0x04,0x04,0xFC,0x00,0x00,
    0x00,0x40,0x20,0x1F,0x20,0x40,0x4F,0x44,0x42,0x40,0x7F,0x42,0x44,0x43,0x40,0x00
};

// 你
const u8 font_16_ni[32] = {
    0x00,0x80,0x60,0xF8,0x07,0x40,0x20,0x18,0x0F,0x08,0xC8,0x08,0x08,0x28,0x18,0x00,
    0x01,0x00,0x00,0xFF,0x00,0x10,0x0C,0x03,0x40,0x80,0x7F,0x00,0x01,0x06,0x18,0x00
};

// 物
const u8 font_16_wu[32] = {
    0x40,0x3C,0x10,0xFF,0x10,0x10,0x20,0x10,0x8F,0x78,0x08,0xF8,0x08,0xF8,0x00,0x00,
    0x02,0x06,0x02,0xFF,0x01,0x01,0x04,0x42,0x21,0x18,0x46,0x81,0x40,0x3F,0x00,0x00
};

// 联
const u8 font_16_lian[32] = {
    0x02,0xFE,0x92,0x92,0xFE,0x02,0x00,0x10,0x11,0x16,0xF0,0x14,0x13,0x10,0x00,0x00,
    0x10,0x1F,0x08,0x08,0xFF,0x04,0x81,0x41,0x31,0x0D,0x03,0x0D,0x31,0x41,0x81,0x00
};

// 网
const u8 font_16_wang[32] = {
    0x00,0xFE,0x02,0x22,0x42,0x82,0x72,0x02,0x22,0x42,0x82,0x72,0x02,0xFE,0x00,0x00,
    0x00,0xFF,0x10,0x08,0x06,0x01,0x0E,0x10,0x08,0x06,0x01,0x4E,0x80,0x7F,0x00,0x00
};

// 工
const u8 font_16_gong[32] = {
    0x00,0x04,0x04,0x04,0x04,0x04,0x04,0xFC,0x04,0x04,0x04,0x04,0x04,0x04,0x00,0x00,
    0x20,0x20,0x20,0x20,0x20,0x20,0x20,0x3F,0x20,0x20,0x20,0x20,0x20,0x20,0x20,0x00
};

// 程
const u8 font_16_cheng[32] = {
    0x24,0x24,0xA4,0xFE,0x23,0x22,0x00,0x3E,0x22,0x22,0x22,0x22,0x22,0x3E,0x00,0x00,
    0x08,0x06,0x01,0xFF,0x01,0x06,0x40,0x49,0x49,0x49,0x7F,0x49,0x49,0x49,0x41,0x00
};

// 焦
const u8 font_16_jiao[32] = {
    0x40,0x20,0x10,0xFC,0x27,0x24,0x24,0x25,0xFE,0x24,0x24,0x24,0x24,0x04,0x00,0x00,
    0x80,0x60,0x00,0x1F,0x29,0xC9,0x09,0x09,0x2F,0xC9,0x09,0x09,0x29,0xC8,0x00,0x00
};

// 琛
const u8 font_16_chen[32] = {
    0x84,0x84,0xFC,0x84,0x84,0x0E,0x22,0x12,0x0A,0xC2,0x0A,0x12,0x22,0x0E,0x00,0x00,
    0x10,0x30,0x1F,0x08,0x28,0x21,0x11,0x09,0x05,0xFF,0x05,0x09,0x11,0x21,0x20,0x00
};

/* ==================================================================
 * 辅助显示函数
 * ================================================================== */

/**
 * @brief 显示32×32字模
 * @param x      起始列坐标
 * @param y_page 起始页（0~3）
 * @param glyph  字模数据（128字节，4页×32列）
 */
void OLED_Display_Glyph32(u8 x, u8 y_page, const u8 *glyph)
{
    u8 i, j;
    for(i = 0; i < 4; i++)               // 4页（32行÷8行/页）
    {
        OLED_Set_Pos(x, y_page + i);      // 设置光标位置
        for(j = 0; j < 32; j++)           // 每页32列
        {
            OLED_SPI_ReadWriteOneByte(glyph[j + i * 32], OLED_DAT);
        }
    }
}

/**
 * @brief 显示16×16字模
 * @param x      起始列坐标
 * @param y_page 起始页（0~3）
 * @param glyph  字模数据（32字节，上半页16字节+下半页16字节）
 */
void OLED_Draw_16x16(u8 x, u8 y_page, const u8 *glyph)
{
    u8 j;
    // 上半部分（前8行）
    OLED_Set_Pos(x, y_page);
    for(j = 0; j < 16; j++)
    {
        OLED_SPI_ReadWriteOneByte(glyph[j], OLED_DAT);
    }
    // 下半部分（后8行）
    OLED_Set_Pos(x, y_page + 1);
    for(j = 16; j < 32; j++)
    {
        OLED_SPI_ReadWriteOneByte(glyph[j], OLED_DAT);
    }
}

/* ==================================================================
 * GBK内码 -> 字模指针 查找表
 * ================================================================== */

/** 汉字映射表结构体 */
typedef struct {
    u8 code[2];      // GBK内码（高位在前，低位在后）
    const u8 *glyph; // 对应的16×16字模指针
} HanziEntry;

/** 查找表：包含所有支持的汉字及其GBK内码 */
const HanziEntry hanzi_table[] = {
    { {0xBB, 0xB6}, font_16_huan  },  // 欢 (GBK: BBB6)
    { {0xD3, 0xAD}, font_16_ying  },  // 迎 (GBK: D3AD)
    { {0xC4, 0xE3}, font_16_ni    },  // 你 (GBK: C4E3)
    { {0xCE, 0xEF}, font_16_wu    },  // 物 (GBK: CEEF)
    { {0xC1, 0xAA}, font_16_lian  },  // 联 (GBK: C1AA)
    { {0xCD, 0xF8}, font_16_wang  },  // 网 (GBK: CDF8)
    { {0xB9, 0xA4}, font_16_gong  },  // 工 (GBK: B9A4)
    { {0xB3, 0xCC}, font_16_cheng },  // 程 (GBK: B3CC)
    { {0xBD, 0xB9}, font_16_jiao  },  // 焦 (GBK: BDB9)
    { {0xE8, 0xB4}, font_16_chen  },  // 琛 (GBK: E8B4)
};

/** 查找表长度 */
#define HANZI_COUNT (sizeof(hanzi_table) / sizeof(hanzi_table[0]))

/* ==================================================================
 * 混合字符串显示函数（核心函数）
 * ================================================================== */

/**
 * @brief 显示GBK编码的混合字符串（ASCII + 已知汉字）
 * @param str 待显示的字符串（以'\0'结尾）
 * 
 * 显示规则：
 * - ASCII字符（0x00~0x7F）：使用8×16字体，每个字符宽8像素
 * - 已知汉字（匹配hanzi_table）：使用16×16字体，每个字宽16像素
 * - 未知汉字（未在表中注册）：显示两个'?'占满16像素宽度
 * 
 * 所有字符高度统一为16像素，从第0页开始绘制，确保对齐。
 */
void OLED_Display_Mixed_Line(u8 *str)
{
    u8 x = 0;          // 当前水平坐标（像素）
    
    while(*str != '\0')
    {
        /* ----- 情况1：ASCII字符（单字节） ----- */
        if(*str < 0x80)
        {
            // 调用OLED驱动中的8×16字符显示函数
            OLED_Display_char(x, 0, 8, 16, *str);
            x += 8;     // 前进8像素
            str++;
        }
        /* ----- 情况2：汉字（双字节，首字节≥0x80） ----- */
        else
        {
            // 防止越界访问（如果字符串末尾只有一个字节，则退出）
            if(*(str + 1) == '\0') break;
            
            u8 found = 0;
            // 遍历查找表，寻找匹配的GBK内码
            for(u8 i = 0; i < HANZI_COUNT; i++)
            {
                if(hanzi_table[i].code[0] == *str &&
                   hanzi_table[i].code[1] == *(str + 1))
                {
                    // 找到匹配，显示对应的16×16字模
                    OLED_Draw_16x16(x, 0, hanzi_table[i].glyph);
                    x += 16;    // 前进16像素
                    found = 1;
                    break;
                }
            }
            
            // 未找到匹配：显示两个'?'占满16像素宽度
            if(!found)
            {
                OLED_Display_char(x,     0, 8, 16, '?');
                OLED_Display_char(x + 8, 0, 8, 16, '?');
                x += 16;
            }
            
            str += 2;   // 跳过两个字节（一个汉字）
        }
        
        /* 防止超出屏幕右边界（128像素，留一些边距） */
        if(x > 112) break;
    }
}